## boards/arm/microzed/Kconfig
```kconfig
config MICROZED_USE_CUSTOM_LINKER
    bool "Enable custom linker script for MicroZed"
    default y
```

## boards/arm/microzed/board.yml
```yaml
board:
  name: microzed
  full_name: Microzed
  vendor: avnet
  socs:
    - name: xc7z010
```

## boards/arm/microzed/microzed_defconfig
```kconfig
CONFIG_SOC_RESET_HOOK=n
CONFIG_ARM_AARCH32_MMU=n
CONFIG_ARM_ARCH_TIMER=y
CONFIG_SYS_CLOCK_HW_CYCLES_PER_SEC=325000000

CONFIG_SERIAL=y
CONFIG_CONSOLE=y
CONFIG_UART_CONSOLE=y

CONFIG_PRINTK=y

CONFIG_NO_OPTIMIZATIONS=y
```

## boards/arm/microzed_new/Kconfig.microzed
```kconfig
config BOARD_MICROZED
  bool "MicroZed"
	select SOC_XILINX_XC7Z010
  help
    Enable support for the Avnet MicroZed board.
```

## boards/arm/microzed_new/board.yml
```yaml
board:
  name: microzed_new
  full_name: Microzed_new
  vendor: avnet
  socs:
    - name: xc7z010
```

## boards/arm/zedboard/Kconfig.zedboard
```kconfig
#
# Kconfig - AVNET/Digilent Zedboard
#
# Copyright (c) 2022, Immo Birnbaum
# SPDX-License-Identifier: Apache-2.0
#

config BOARD_ZEDBOARD
    bool "AVNET/Digilent Zedboard"
	select SOC_XILINX_XC7Z010
```

## boards/arm/zedboard/board.yml
```yaml
board:
  name: zedboard
  full_name: AVNET/Digilent Zedboard
  vendor: avnet
  socs:
    - name: xc7z010
```

## drivers/flash/Kconfig.nxp_s32k1xx
```kconfig
# SPDX-License-Identifier: Apache-2.0

menuconfig FLASH_NXP_S32K1XX
    bool "NXP S32K1xx internal flash driver"
    depends on SOC_S32K148
    select FLASH_HAS_DRIVER_ENABLED
    select FLASH_HAS_PAGE_LAYOUT      # ensure page layout API is available
    help
      Enable on-chip program flash driver for NXP S32K1xx devices (FTFC).
      This driver provides read/erase/write support for the internal flash
      and integrates with Zephyr's flash map subsystem.

if FLASH_NXP_S32K1XX

config FLASH_NXP_S32K1XX_VERIFY
    bool "Verify after write"
    default y
    help
      Read back and compare after write for robustness.

endif # FLASH_NXP_S32K1XX
```

## dts/bindings/flash_controller/nxp,s32k1xx-flash.yaml
```yaml
# SPDX-License-Identifier: Apache-2.0
title: NXP S32K1xx internal program flash

description: >
  Internal program flash array for S32K1xx. The node represents the memory-mapped
  flash array that Zephyr should use for storage and MCUboot.

compatible: "nxp,s32k1xx-flash"

include: soc-nv-flash.yaml

properties:
  erase-block-size:
    type: int
    required: true
  write-block-size:
    type: int
    required: true
```
